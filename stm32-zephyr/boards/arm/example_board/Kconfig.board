## stm32-zephyr/boards/arm/example_board/Kconfig.defconfig
```kconfig
if BOARD_EXAMPLE_BOARD

config BOARD
	default "example_board"

config SPI_STM32_INTERRUPT
	default y
	depends on SPI

endif # BOARD_EXAMPLE_BOARD
```
